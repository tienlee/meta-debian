## bsp/meta-xilinx/conf/layer.conf
```bitbake
# We have a conf and classes directory, add to BBPATH
BBPATH =. "${LAYERDIR}:"

# We have recipes-* directories, add to BBFILES
BBFILES += "${LAYERDIR}/recipes-*/*/*.bb \
            ${LAYERDIR}/recipes-*/*/*.bbappend"

BBFILE_COLLECTIONS += "debian-xilinx"
BBFILE_PATTERN_debian-xilinx = "^${LAYERDIR}/"
BBFILE_PRIORITY_debian-xilinx = "10"

# This should only be incremented on significant changes that will
# cause compatibility issues with other layers
LAYERVERSION_debian-xilinx = "1"

LAYERDEPENDS_debian-xilinx = "debian xilinx"

LAYERSERIES_COMPAT_debian-xilinx = "warrior"

MACHINE_ESSENTIAL_EXTRA_RDEPENDS_append = " device-tree"
```
